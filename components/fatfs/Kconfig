## components/feckless_graphics_handler/Kconfig
```kconfig
menu "feckless_graphics_handler"

    config FECKLESS_GFX_BLIT_STATS
        bool "Log where gfx_blit()'s time goes (diagnostic)"
        default n
        help
            u-feckless-0032. Every 100 blits, logs the average blit and its
            parts: waiting for the blit lock, the brightness filter's copy
            into the scratch, esp_lcd_panel_draw_bitmap() (retries
            included), waiting for the transfer to finish, and the one-tick
            gaps between the bands a big blit is split into -- with the
            bands and rows a blit averaged. Costs a timer read per part.

    config FECKLESS_GFX_BLIT_GAP_US
        int "Gap between the bands of a big blit, microseconds (0: one tick)"
        default 0
        range 0 5000
        help
            u-feckless-0033. A blit taller than 600 rows goes out in bands of
            240 with a gap between them, so the panel's own refresh DMA gets
            the bus (the flash it fixed was a whole-strip repaint). 0 keeps
            the gap as it was, vTaskDelay(1): up to a tick each, about 1 ms
            at 1000 Hz, which on Lothesome's 940-row frames is 3 ms of a 14 ms
            blit (CONFIG_FECKLESS_GFX_BLIT_STATS). A value here waits that
            many microseconds instead, on the CPU. Lower it until the panel
            flashes, then raise it.

endmenu
```

## components/feckless_umode/Kconfig
```kconfig
menu "feckless_umode"

    config FECKLESS_UMODE_PREEMPTIBLE
        bool "Let interrupts land inside a U-mode window (experimental)"
        default n
        help
            By default a window raises the CLIC threshold to its maximum, so
            no interrupt is taken while the boxed program runs; they are
            serviced at the next syscall or exit.  Enabling this leaves the
            threshold alone and re-pends edge-triggered lines claimed by the
            private vector.  On an ESP32-P4 rev 1.3 Tab5 (u-feckless-0016)
            this stopped the tick on CPU0 and tripped the interrupt watchdog;
            leave it off unless investigating that.

    config FECKLESS_UMODE_CALL_STATS
        bool "Log what a boxed app's host calls cost (diagnostic)"
        default n
        help
            u-feckless-0029. Every CONFIG_FECKLESS_UMODE_CALL_STATS_SECONDS
            the loaded app's busiest host calls are logged: how many a
            second, the microseconds each took in the host, and the share
            of a second that is -- and, per thread, how many calls it made
            and how long it spent in them. A host call is a trap each way,
            so an app that makes tens of thousands a second (soft-float
            doubles are one each) shows here. Costs two timer reads and two
            atomic adds a call.

    config FECKLESS_UMODE_CALL_STATS_SECONDS
        int "Seconds between call-stat lines"
        depends on FECKLESS_UMODE_CALL_STATS
        default 5
        range 1 60

endmenu
```
