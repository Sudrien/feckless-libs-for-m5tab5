## components/feckless_graphics_handler/Kconfig
```kconfig
menu "feckless_graphics_handler"

    config FECKLESS_GFX_BLIT_STATS
        bool "Log where gfx_blit()'s time goes (diagnostic)"
        default n
        help
            u-feckless-0032. Every 100 blits, logs the average blit and its
            parts: waiting for the blit lock, the brightness filter's copy
            into the scratch, esp_lcd_panel_draw_bitmap() (retries
            included), waiting for the transfer to finish, and the one-tick
            gaps between the bands a big blit is split into -- with the
            bands and rows a blit averaged. Costs a timer read per part.

    config FECKLESS_GFX_BLIT_GAP_US
        int "Gap between the bands of a big blit, microseconds (0: one tick)"
        default 0
        range 0 5000
        help
            u-feckless-0033. A blit taller than 600 rows goes out in bands of
            240 with a gap between them, so the panel's own refresh DMA gets
            the bus (the flash it fixed was a whole-strip repaint). 0 keeps
            the gap as it was, vTaskDelay(1): up to a tick each, about 1 ms
            at 1000 Hz, which on Lothesome's 940-row frames is 3 ms of a 14 ms
            blit (CONFIG_FECKLESS_GFX_BLIT_STATS). A value here waits that
            many microseconds instead, on the CPU. Lower it until the panel
            flashes, then raise it.

    config FECKLESS_GFX_PPA
        bool "Turn rotated and upside-down blits with the PPA"
        default y
        help
            u-feckless-0057. At 90, 180 and 270 degrees a blit's band is
            turned into a scratch before it goes to the panel. With this on,
            the P4's PPA does the turn in hardware; off, the CPU does it a
            pixel at a time, as before -- about 84 ms for a whole 1280x720
            frame at 90. A band the brightness filter is dimming (a fade) is
            turned on the CPU either way. If the PPA cannot be had or a turn
            fails, gfx logs it once and uses the CPU from then on.

endmenu
```

## components/feckless_umode/Kconfig
```kconfig
menu "feckless_umode"

    config FECKLESS_UMODE_PREEMPTIBLE
        bool "Let interrupts land inside a U-mode window (experimental)"
        default n
        help
            By default a window raises the CLIC threshold to its maximum, so
            no interrupt is taken while the boxed program runs; they are
            serviced at the next syscall or exit.  Enabling this leaves the
            threshold alone and re-pends edge-triggered lines claimed by the
            private vector.  On an ESP32-P4 rev 1.3 Tab5 (u-feckless-0016)
            this stopped the tick on CPU0 and tripped the interrupt watchdog;
            leave it off unless investigating that.

    config FECKLESS_UMODE_CALL_STATS
        bool "Log what a boxed app's host calls cost (diagnostic)"
        default n
        help
            u-feckless-0029. Every CONFIG_FECKLESS_UMODE_CALL_STATS_SECONDS
            the loaded app's busiest host calls are logged: how many a
            second, the microseconds each took in the host, and the share
            of a second that is -- and, per thread, how many calls it made
            and how long it spent in them. A host call is a trap each way,
            so an app that makes tens of thousands a second (soft-float
            doubles are one each) shows here. Costs two timer reads and two
            atomic adds a call.

    config FECKLESS_UMODE_CALL_STATS_SECONDS
        int "Seconds between call-stat lines"
        depends on FECKLESS_UMODE_CALL_STATS
        default 5
        range 1 60

    config FECKLESS_UMODE_HOST_STACK_PSRAM
        bool "Host tasks' stacks in PSRAM"
        depends on SPIRAM && FREERTOS_TASK_CREATE_ALLOW_EXT_MEM
        default y
        help
            u-feckless-0082. Each of a boxed app's threads, and app_main,
            runs on a host task of its own: 8 KB of stack each (16 KB for
            app_main), which was internal RAM -- nine threads were 88 KB of
            it, and Defeatist's podcast download then ran the internal heap
            down to 52 bytes, with the AES engine failing for want of DMA
            descriptors. With this on those stacks come from PSRAM, as the
            app's own stacks in the box already do.

            A task whose stack is in PSRAM must not touch flash itself: a
            flash operation turns the cache off, PSRAM with it, and ESP-IDF
            asserts. So a host call that reaches flash has to run it on a
            task with an internal stack -- feckless_box_calls does, for NVS
            and the first feckless_https_start() (box_flash.c). A launcher
            with host calls of its own that touch flash turns this off, or
            does the same.

endmenu
```
